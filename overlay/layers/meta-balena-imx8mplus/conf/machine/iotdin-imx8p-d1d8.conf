## overlay/layers/meta-balena-imx8mplus/conf/machine/iotdin-imx8p-d1d8.conf
```bitbake
#@TYPE: Machine
#@NAME: CompuLab IOTDIN-IMX8P-D1D8 - Industrial IoT Gateway
#@SOC: i.MX8MP
#@DESCRIPTION: Machine configuration for IOTdIN-IMX8P D1D8

MACHINEOVERRIDES =. "iotdin-imx8p:${MACHINE}:"

include conf/machine/iotdin-imx8p.conf

DRAM_CONF = "d1d8"
```
